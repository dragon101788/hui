## Kconfig
```kconfig
mainmenu "HUI Configuretion"


comment "------------HUI Configuretion---------"

config  USING_FONT
        bool "Using TTF Font"

config  REVERSE_SCREEN
        bool "reverse screen to 180 degree"

choice 
        prompt "alpha channel render"
        default ALPHA_SOFT
        help
		select alpha channel render
config ALPHA_SOFT
        bool "Soft Alpha"
        help
		soft
config ALPHA_BLT
        bool "Nuvoton 2D Blitting Accelerator"
        help
		2d Bltting
endchoice

config  FB_SOFT_RGB565
        bool "FrameBuffer Soft Rgb565 output"
choice 
        prompt "Touch Panel Device"
        default TOUCH_NONE
        help
		select alpha channel render
config TOUCH_NONE
        bool "none"
        help
		soft
config TOUCH_EKTF2K
        bool "ektf2k"
        help
		2d Bltting
config TOUCH_TSLIB
        bool "tslib"
        help
		use tslib		
endchoice
choice 
        prompt "Keypad Device"
        default Keypad_NONE
        help
		select keypad devices
config KEYPAD_NONE
        bool "none"
        help
		no keypad
config  KEYPAD_LITTLESWAN
        bool "keypad littleSwan"
        help
		enable keypad littleSwan
endchoice
config DEBUG
	bool "enable debug"
choice 
        prompt "debug  log level"
        default LOG_I
        help
		select log msg level
config LOG_I
        bool "log_i"
        help
		enable log_i,log_w,log_s,log_e
config LOG_W
        bool "log_w"
        help
		enable log_w,log_s,log_e
config LOG_S
        bool "log_s"
        help
		enable log_s,log_e
config LOG_E
        bool "log_e"
        help
		enable log_e
config LOG_NONE
        bool "none "
        help
		none log msg print
endchoice

comment "------------Dragon Auto Configuretion---------"
source Kconfig.auto
```

## widget/list_view/Kconfig.in
```kconfig
config  CONTROL_LIST_VIEW 
        bool "list_view Control" 
        help 
			path=$AUTOPATH
```

## widget/rotate/Kconfig.in
```kconfig
config  CONTROL_ROTATE_IMAGE 
        bool "rotate_image Control" 
        help 
			path=$AUTOPATH
```

## widget/screen_lock/Kconfig.in
```kconfig
config  CONTROL_SCREEN_LOCK 
        bool "screen_lock Control" 
        help 
		path=$AUTOPATH
```

## widget/simple_fragment/Kconfig.in
```kconfig
config  CONTROL_SIMPLE_FRAGMENT 
        bool "simple_fragment Control" 
        help 
			path=$AUTOPATH
```

## widget/switch_button/Kconfig.in
```kconfig
config  CONTROL_SWITCH_BUTTON 
        bool "switch_button Control" 
        help 
			path=$AUTOPATH
```

## widget/text_reader/Kconfig.in
```kconfig
config  CONTROL_TEXT_READER 
        bool "text_reader Control" 
        help 
			path=$AUTOPATH
```

## widget/touch_wheel/Kconfig.in
```kconfig
config  CONTROL_TOUCH_WHEEL 
        depends on USING_FONT 
        bool "touch wheel Control" 
        help 
			path=$AUTOPATH
```

## widget/zhang/button_group/Kconfig.in
```kconfig
config  CONTROL_OLD_BUTTON_GROUP 
        bool "old_button group Control" 
        help 
			path=$AUTOPATH
```

## widget/zhang/keys_slip_menu/Kconfig.in
```kconfig
config  CONTROL_KEYS_SLIP_MENU 
        bool "keys_slip_menu Control" 
        help 
			path=$AUTOPATH
```

## widget/zhang/slip_fragment/Kconfig.in
```kconfig
config  CONTROL_SLIP_FRAGMENT 
        bool "slip_fragment Control" 
        help 
			path=$AUTOPATH
```

## widget/zhang/text_button/Kconfig.in
```kconfig
config  CONTROL_TEXT_BUTTON 
        bool "text_button Control" 
        help 
			path=$AUTOPATH
```

## widget/zhang/wheel_text/Kconfig.in
```kconfig
config  CONTROL_WHEEL_TEXT 
        depends on USING_FONT 
        bool "wheel_text Control" 
        help 
			path=$AUTOPATH
```

## widget/zoom_image/Kconfig.in
```kconfig
config  CONTROL_ZOOM_IMAGE 
        bool "zoom_image Control" 
        help 
			path=$AUTOPATH
```
